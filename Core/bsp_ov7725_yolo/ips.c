#include "ips.h"
#include "spi.h"
#include "ips_gui.h"

#define IPS_SPI hspi1

/************************************5*8************************************/
const unsigned char F6x8[][6] =		
{
0x00, 0x00, 0x00, 0x00, 0x00, 0x00,// sp
0x00, 0x00, 0x00, 0x2f, 0x00, 0x00,// !
0x00, 0x00, 0x07, 0x00, 0x07, 0x00,// "
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0x14, 0x14, 0x14, 0x14, 0x14, 0x14,// horiz lines
};

void LCD_Reset(void)
{
	HAL_GPIO_WritePin(RES_GPIO, RES_PIN, GPIO_PIN_RESET);
	HAL_Delay(20);
	HAL_GPIO_WritePin(RES_GPIO, RES_PIN, GPIO_PIN_SET);
	HAL_Delay(20);
}

void LCD_WriteData_Byte(uint8_t da) 
{	
	HAL_GPIO_WritePin(DC_GPIO, DC_PIN, GPIO_PIN_SET);
	HAL_SPI_Transmit(&IPS_SPI, (uint8_t *)&da, 1, 500);
}

 void LCD_WriteData_Word(uint16_t da)
{
	uint8_t i=(da>>8)&0xff;	//高八位
	HAL_GPIO_WritePin(DC_GPIO, DC_PIN, GPIO_PIN_SET);
	HAL_SPI_Transmit(&IPS_SPI, (uint8_t *)&i, 1, 500);
	HAL_SPI_Transmit(&IPS_SPI, (uint8_t *)&da, 1, 500);
}	

void LCD_WriteReg(uint8_t da)	 
{	
	HAL_GPIO_WritePin(DC_GPIO, DC_PIN, GPIO_PIN_RESET);
	HAL_SPI_Transmit(&IPS_SPI, (uint8_t *)&da, 1, 500);
}

void LCD_DrawPoint(uint16_t x, uint16_t y, uint16_t color)
{
	LCD_SetCursor(x,y,x,y);
	LCD_WriteData_Word(color);
}

void LCD_ShowChar(uint16_t x, uint16_t y, uint8_t ch, uint16_t color)
{
	uint8_t i,j,font_data;
	ch = ch-' ';
	for(i=0;i<6;i++)
	{
		font_data = F6x8[ch][i];
		for(j=0;j<8;j++)
		{
			if((font_data&(1<<j)) != 0)
				//LCD_DrawPoint(x,y,color);
				GUI_DrawPoint(x,y,color);
			else
				//LCD_DrawPoint(x,y,WHITE);
				GUI_DrawPoint(x,y,WHITE);
			y++;
		}
		x++;
		y-=8;
	}
}

void LCD_ShowString(uint16_t x, uint16_t y, uint8_t * ch, uint16_t color)
{
	uint8_t i = 0;
	while(ch[i] != '\0')
	{
		LCD_ShowChar(x,y,ch[i],color);
		x+=6;
		i++;
	}
}

void LCD_Init(void)
{
	LCD_Reset();

	//************* Start Initial Sequence **********// 
	LCD_WriteReg(0x11);//Sleep exit 
	HAL_Delay (120);
  LCD_WriteReg(0x21); 
  LCD_WriteReg(0x21); 

  LCD_WriteReg(0xB1); 
  LCD_WriteData_Byte(0x05);
  LCD_WriteData_Byte(0x3A);
  LCD_WriteData_Byte(0x3A);

  LCD_WriteReg(0xB2);
  LCD_WriteData_Byte(0x05);
  LCD_WriteData_Byte(0x3A);
  LCD_WriteData_Byte(0x3A);

  LCD_WriteReg(0xB3); 
  LCD_WriteData_Byte(0x05);  
  LCD_WriteData_Byte(0x3A);
  LCD_WriteData_Byte(0x3A);
  LCD_WriteData_Byte(0x05);
  LCD_WriteData_Byte(0x3A);
  LCD_WriteData_Byte(0x3A);

  LCD_WriteReg(0xB4);
  LCD_WriteData_Byte(0x03);

  LCD_WriteReg(0xC0);
  LCD_WriteData_Byte(0x62);
  LCD_WriteData_Byte(0x02);
  LCD_WriteData_Byte(0x04);

  LCD_WriteReg(0xC1);
  LCD_WriteData_Byte(0xC0);

  LCD_WriteReg(0xC2);
  LCD_WriteData_Byte(0x0D);
  LCD_WriteData_Byte(0x00);

  LCD_WriteReg(0xC3);
  LCD_WriteData_Byte(0x8D);
  LCD_WriteData_Byte(0x6A);   

  LCD_WriteReg(0xC4);
  LCD_WriteData_Byte(0x8D); 
  LCD_WriteData_Byte(0xEE); 

  LCD_WriteReg(0xC5);  /*VCOM*/
  LCD_WriteData_Byte(0x0E);    

  LCD_WriteReg(0xE0);
  LCD_WriteData_Byte(0x10);
  LCD_WriteData_Byte(0x0E);
  LCD_WriteData_Byte(0x02);
  LCD_WriteData_Byte(0x03);
  LCD_WriteData_Byte(0x0E);
  LCD_WriteData_Byte(0x07);
  LCD_WriteData_Byte(0x02);
  LCD_WriteData_Byte(0x07);
  LCD_WriteData_Byte(0x0A);
  LCD_WriteData_Byte(0x12);
  LCD_WriteData_Byte(0x27);
  LCD_WriteData_Byte(0x37);
  LCD_WriteData_Byte(0x00);
  LCD_WriteData_Byte(0x0D);
  LCD_WriteData_Byte(0x0E);
  LCD_WriteData_Byte(0x10);

  LCD_WriteReg(0xE1);
  LCD_WriteData_Byte(0x10);
  LCD_WriteData_Byte(0x0E);
  LCD_WriteData_Byte(0x03);
  LCD_WriteData_Byte(0x03);
  LCD_WriteData_Byte(0x0F);
  LCD_WriteData_Byte(0x06);
  LCD_WriteData_Byte(0x02);
  LCD_WriteData_Byte(0x08);
  LCD_WriteData_Byte(0x0A);
  LCD_WriteData_Byte(0x13);
  LCD_WriteData_Byte(0x26);
  LCD_WriteData_Byte(0x36);
  LCD_WriteData_Byte(0x00);
  LCD_WriteData_Byte(0x0D);
  LCD_WriteData_Byte(0x0E);
  LCD_WriteData_Byte(0x10);

  LCD_WriteReg(0x3A); 
  LCD_WriteData_Byte(0x05);

  LCD_WriteReg(0x36);
  LCD_WriteData_Byte(0xA8);//

  LCD_WriteReg(0x29); 
} 

/******************************************************************************
function:	Set the cursor position
parameter	:
		Xstart: 	Start UWORD x coordinate
	  Ystart:		Start UWORD y coordinate
	  Xend  :		End UWORD coordinates
	  Yend  :		End UWORD coordinatesen
******************************************************************************/
void LCD_SetCursor(uint16_t Xstart, uint16_t Ystart, uint16_t Xend, uint16_t  Yend)
{ 
	Xstart = Xstart+1;
	Xend = Xend+1;
	Ystart = Ystart+26;
	Yend = Yend+26;
	LCD_WriteReg(0x2a);
	LCD_WriteData_Byte(Xstart>>8);
	LCD_WriteData_Byte(Xstart);
	LCD_WriteData_Byte(Xend >>8);
	LCD_WriteData_Byte(Xend );

	LCD_WriteReg(0x2b);
	LCD_WriteData_Byte(Ystart>>8);
	LCD_WriteData_Byte(Ystart);
	LCD_WriteData_Byte(Yend>>8);
	LCD_WriteData_Byte(Yend);

	LCD_WriteReg(0x2C);
}

void LCD_Clear(uint16_t Color)
{
	uint16_t i,j;  	
	LCD_SetCursor(0,0,LCD_WIDTH-1,LCD_HEIGHT-1);
	for(i = 0; i < LCD_WIDTH; i++){
		for(j = 0; j < LCD_HEIGHT; j++){
			LCD_WriteData_Word(Color);
		}
	 }
}
